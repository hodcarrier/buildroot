## configs/loongson_ls1c300_defconfig
```kconfig
BR2_mipsel=y
BR2_mips_32r2=y
BR2_KERNEL_HEADERS_5_15=y
BR2_SYSTEM_DHCP="eth0"
BR2_LINUX_KERNEL=y
BR2_LINUX_KERNEL_CUSTOM_VERSION=y
BR2_LINUX_KERNEL_CUSTOM_VERSION_VALUE="6.0.7"
BR2_LINUX_KERNEL_USE_CUSTOM_CONFIG=y
BR2_LINUX_KERNEL_CUSTOM_CONFIG_FILE="board/loongson/ls1c300/linux.config"
BR2_LINUX_KERNEL_VMLINUZ=y
BR2_TARGET_ROOTFS_INITRAMFS=y
# BR2_TARGET_ROOTFS_TAR is not set
```
